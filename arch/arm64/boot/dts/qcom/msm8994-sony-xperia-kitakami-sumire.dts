// SPDX-License-Identifier: BSD-3-Clause
/*
 * Copyright (c) 2020, Konrad Dybcio <konrad.dybcio@somainline.org>
 */

/dts-v1/;

#include "msm8994-sony-xperia-kitakami.dtsi"

/ {
	model = "Sony Xperia Z5";
	compatible = "sony,sumire-row", "qcom,msm8994";
	chassis-type = "handset";
};

/delete-node/ &vreg_l19a_3p3;
