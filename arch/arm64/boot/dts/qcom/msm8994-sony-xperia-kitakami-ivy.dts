// SPDX-License-Identifier: BSD-3-Clause
/*
 * Copyright (c) 2020, Konrad Dybcio <konrad.dybcio@somainline.org>
 */

/dts-v1/;

#include "msm8994-sony-xperia-kitakami.dtsi"

/ {
	model = "Sony Xperia Z3+/Z4";
	compatible = "sony,ivy-row", "qcom,msm8994";
	chassis-type = "handset";
};

&vreg_l3a_1p2 {
	regulator-min-microvolt = <1000000>;
	regulator-max-microvolt = <1000000>;
};

&vreg_l17a_2p7 {
	regulator-min-microvolt = <2700000>;
	regulator-max-microvolt = <2700000>;
};

/delete-node/ &vreg_l19a_3p3;
/delete-node/ &vreg_l32a_1p8;
