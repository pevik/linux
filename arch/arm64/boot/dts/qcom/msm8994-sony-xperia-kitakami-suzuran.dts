// SPDX-License-Identifier: BSD-3-Clause
/*
 * Copyright (c) 2020, Konrad Dybcio <konrad.dybcio@somainline.org>
 */

/dts-v1/;

#include "msm8994-sony-xperia-kitakami.dtsi"

/ {
	model = "Sony Xperia Z5 Compact";
	compatible = "sony,suzuran-row", "qcom,msm8994";
	chassis-type = "handset";
};

&vreg_l14a_1p8 {
	regulator-min-microvolt = <2000000>;
	regulator-max-microvolt = <2000000>;
};

/delete-node/ &vreg_l19a_3p3;
